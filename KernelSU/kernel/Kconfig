## KernelSU/kernel/Kconfig
```kconfig
# SPDX-License-Identifier: GPL-2.0-or-later
#
# KernelSU stock — Kconfig
# Selected via CONFIG_KSU_VARIANT_STOCK=y
#

menu "KernelSU (stock / tiann)"

config KSU_STOCK
	tristate "KernelSU stock support"
	default y if KSU_VARIANT_STOCK
	depends on KSU_VARIANT_STOCK
	help
	  Enable the stock (tiann/KernelSU) root engine.
	  Reports UAPI version 6 to the manager application.
	  Requires manual-hook integration in the kernel.

config KSU_STOCK_DEBUG
	bool "KernelSU stock debug mode"
	depends on KSU_STOCK
	default n
	help
	  Enable verbose kernel logging for the stock KSU variant.

config KSU_STOCK_SUSFS
	bool "KernelSU stock — SUSFS integration"
	depends on KSU_STOCK
	depends on THREAD_INFO_IN_TASK
	default y
	help
	  Enable SUSFS (SUS File System) with the stock KernelSU variant.
	  Requires susfs patches to be applied to the kernel source.

endmenu
```

## drivers/aether/Kconfig
```kconfig
# SPDX-License-Identifier: GPL-2.0-only
menuconfig AETHER_ENGINE
	bool "AETHER Closed-Loop Kernel Performance Engine"
	default y
	help
	  AETHER Engine provides hardware deadline-aware scheduling, sub-frame
	  VSYNC salvage, slack-time energy harvesting, and bottleneck attribution
	  for Qualcomm Snapdragon platforms.

	  If unsure, say Y.
```

## drivers/net/rekernel/Kconfig
```kconfig
menu "Re:Kernel"

config REKERNEL
	bool "Re:Kernel support"
	depends on NET
	default y
	help
	  In-tree Re:Kernel integration for non-GKI kernels.

	  It creates a netlink server which reports binder transactions,
	  signals and incoming network packets that concern frozen (cached)
	  applications, so that userspace can unfreeze them instead of
	  letting them be killed ("tombstoned").

	  If unsure, say Y.

config REKERNEL_NETWORK
	bool "Re:Kernel network monitoring"
	depends on REKERNEL && NETFILTER && INET
	default y
	help
	  Report incoming TCP traffic of user applications through the
	  Re:Kernel netlink socket.

	  If unsure, say Y.

config REKERNEL_DEBUG
	bool "Re:Kernel debug messages"
	depends on REKERNEL
	default n
	help
	  Enable Re:Kernel debug logging.

endmenu
```
